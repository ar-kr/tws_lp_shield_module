## boards/shields/tws_lp_jis60/Kconfig.defconfig
```kconfig
if SHIELD_TWS_LP_JIS60_RIGHT

# Name must be less than 16 characters long!
config ZMK_KEYBOARD_NAME
    default "tws_lp_jis60"

config ZMK_SPLIT_ROLE_CENTRAL
    default y

config USB_DEVICE_PRODUCT
    default "tws_lp_jis60 Right"

config BT_DEVICE_NAME
    default "tws_lp_jis60 Right"

endif

if SHIELD_TWS_LP_JIS60_LEFT

config ZMK_SPLIT_ROLE_CENTRAL
    default n

config USB_DEVICE_PRODUCT
    default "tws_lp_jis60 Left"

config BT_DEVICE_NAME
    default "tws_lp_jis60 Left"

endif

if SHIELD_TWS_LP_JIS60_LEFT || SHIELD_TWS_LP_JIS60_RIGHT

config ZMK_SPLIT
    default y

endif
```

## boards/shields/tws_lp_jis60/Kconfig.shield
```kconfig
config SHIELD_TWS_LP_JIS60_LEFT
    def_bool $(shields_list_contains,tws_lp_jis60_left)

config SHIELD_TWS_LP_JIS60_RIGHT
    def_bool $(shields_list_contains,tws_lp_jis60_right)
```
